## Kconfig
```kconfig
config INPUT_PINNACLE_ZFILTER
	bool "Cirque Pinnacle trackpads"
	default y
	depends on GPIO
	depends on SPI || I2C
	depends on INPUT
	depends on DT_HAS_CIRQUE_PINNACLE_ZFILTER_ENABLED
	help
	  Enable driver for Cirque Pinnacle trackpads with z filtering for a curved
	  profile.
```

## dts/bindings/input/cirque,pinnacle-zfilter-common.yaml
```yaml
properties:
  data-ready-gpios:
    type: phandle-array

  sensitivity:
    type: string
    default: "1x"
    enum:
      - "1x"
      - "2x"
      - "3x"
      - "4x"

  invert-x:
    type: boolean
  invert-y:
    type: boolean

  clamp-x-min:
    type: int
    default: 128
  clamp-x-max:
    type: int
    default: 1920
  clamp-y-min:
    type: int
    default: 64
  clamp-y-max:
    type: int
    default: 1472

  x-div:
    type: int
    default: 4
    description: |
      x value will be divided by this value.
  y-div:
    type: int
    default: 3
    description: |
      y value will be divided by this value.
```

## dts/bindings/input/cirque,pinnacle-zfilter-i2c.yaml
```yaml
description: Driver for Cirque Pinnacle (I2C)
compatible: "cirque,pinnacle-zfilter"
include: ["i2c-device.yaml", "cirque,pinnacle-zfilter-common.yaml"]
```

## dts/bindings/input/cirque,pinnacle-zfilter-spi.yaml
```yaml
description: Driver for Cirque Pinnacle (SPI)
compatible: "cirque,pinnacle-zfilter"
include: ["spi-device.yaml", "cirque,pinnacle-zfilter-common.yaml"]
```
